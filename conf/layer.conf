## conf/layer.conf
```bitbake
# We have a conf and classes directory, add to BBPATH
BBPATH .= ":${LAYERDIR}"

# We have recipes-* directories, add to BBFILES
BBFILES += "${LAYERDIR}/recipes-*/*/*.bb \
            ${LAYERDIR}/recipes-*/*/*.bbappend"

BBFILE_COLLECTIONS += "meta-watchpoint-mod"
BBFILE_PATTERN_meta-watchpoint-mod = "^${LAYERDIR}/"
BBFILE_PRIORITY_meta-watchpoint-mod = "1"

LAYERDEPENDS_meta-watchpoint-mod = "core"
LAYERSERIES_COMPAT_meta-watchpoint-mod = "mickledore"
```

## recipes_and_conf/conf/layer.conf
```bitbake
# We have a conf and classes directory, add to BBPATH
BBPATH .= ":${LAYERDIR}"

# We have recipes-* directories, add to BBFILES
BBFILES += "${LAYERDIR}/recipes-*/*/*.bb ${LAYERDIR}/recipes-*/*/*.bbappend"

BBFILE_COLLECTIONS += "watchpoint"
BBFILE_PATTERN_watchpoint = "^${LAYERDIR}/"
BBFILE_PRIORITY_watchpoint = "1"

# This should only be incremented on significant changes that will
# cause compatibility issues with other layers
LAYERVERSION_watchpoint = "1"

LAYERDEPENDS_watchpoint = "core"

LAYERSERIES_COMPAT_watchpoint = "nanbield"
```
